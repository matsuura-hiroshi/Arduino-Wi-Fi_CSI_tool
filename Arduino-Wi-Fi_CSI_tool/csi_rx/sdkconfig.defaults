## Arduino-Wi-Fi_CSI_tool/csi_rx/sdkconfig.defaults
```kconfig
# menuconfig 不要：idf.py build が自動で取り込む既定値
CONFIG_ESP_WIFI_CSI_ENABLED=y
CONFIG_ESPTOOLPY_MONITOR_BAUD=921600
CONFIG_ESP_CONSOLE_UART_BAUDRATE=921600
CONFIG_FREERTOS_HZ=1000
```
